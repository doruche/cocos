#include <kernel/arch/qemu-virt.h>
#include <config.h>

OUTPUT_ARCH(riscv)
ENTRY(_start);

SECTIONS {
    . = USER_BASE;

    .text : ALIGN(4K) {
        __stext = .;
        *(.text.entry)
        *(.text .text.*)
        __etext = .;
    }

    .rodata : ALIGN(4K) {
        __srodata = .;
        *(.rodata .rodata.*)
        __erodata = .;
    }

    .data : ALIGN(4K) {
        __sdata = .;
        *(.data .data.*)
        *(.sdata .sdata.*)
        *(COMMON)
        __edata = .;
    }

    .bss : ALIGN(4K) {
        __sbss = .;
        *(.bss .bss.*)
        *(.sbss .sbss.*)
        *(COMMON)
        __ebss = .;
    }

    . = ALIGN(4K);
    __euser = .;

    . = BIOS_BASE - USTACK_SIZE;
    .ustack : ALIGN(4K) {
        __ustack_bottom = .;
        . += USTACK_SIZE;
        __ustack_top = .;
    }  

    /DISCARD/ : {
        *(.comment)
        *(.riscv.attributes)
        *(.note.GNU-stack) 
    }
}