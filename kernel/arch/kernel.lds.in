#include <kernel/arch/qemu-virt.h>
#include <ld_asm_defs.h>

OUTPUT_ARCH(riscv)
ENTRY(_start);

SECTIONS {
    . = KERN_BASE;

    .text : ALIGN(4K) {
        __stext = .;
        *(.text.entry)
        *(.text .text.*)
        __etext = .;    
    }

    .rodata : ALIGN(4K) {
        __srodata = .;
        *(.rodata .rodata.*)
        __erodata = .;
    }

    .data : ALIGN(4K) {
        __sdata = .;
        *(.data .data.*)
        *(.sdata .sdata.*)
        __edata = .;
    }

    .bss : ALIGN(4K) {
        __sbss = .;
        *(.bss .bss.*)
        *(.sbss .sbss.*)
        *(COMMON)
        __ebss = .;
    }

    . = ALIGN(4K);
    .stack : {
        __stack0_guard = .;
        . += PAGE_SIZE;
        __stack0_bottom = .;
        . += BOOT_STACK_SIZE * NCPU;
        __stack0_top = .;
    }
    
    // no need to align.

    __ekern = .;
    __smem = .;

    /DISCARD/ : { 
        *(.comment)
        *(.riscv.attributes)
        *(.note.GNU-stack) 
    }
}