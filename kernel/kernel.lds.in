#include "ld_asm_defs.h"

OUTPUT_ARCH(riscv)
ENTRY(_start);

SECTIONS {
    . = KERN_BASE;

    .text : ALIGN(4K) {
        __stext = .;
        *(.text.entry)
        *(.text .text.*)
        __etext = .;    
    }

    .rodata : ALIGN(4K) {
        __srodata = .;
        *(.rodata .rodata.*)
        __erodata = .;
    }

    .data : ALIGN(4K) {
        __sdata = .;
        *(.data .data.*)
        __edata = .;
    }

    .bss : ALIGN(4K) {
        __sbss = .;
        *(.bss .bss.*)
        *(.sbss .sbss.*)
        *(COMMON)
        __ebss = .;
    }

    . = ALIGN(4K);
    .stack : {
        __boot_stacks_bottom = .;
        . += BOOT_STACK_SIZE * NCPU;
        __boot_stacks_top = .;
    }
    
    // no need to align.

    __ekern = .;
    __smem = .;

    /DISCARD/ : { 
        *(.comment)
        *(.riscv.attributes)
        *(.note.GNU-stack) 
    }
}